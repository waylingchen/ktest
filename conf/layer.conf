## conf/layer.conf
```bitbake
# We have a conf and classes directory, add to BBPATH
BBPATH .= ":${LAYERDIR}"

# We have recipes-* directories, add to BBFILES
BBFILES += "${LAYERDIR}/recipes-*/*/*.bb \
            ${LAYERDIR}/recipes-*/*/*.bbappend"


LAYERSERIES_COMPAT_ktest = "kirkstone"
BBFILE_COLLECTIONS += "ktest"
BBFILE_PATTERN_ktest = "^${LAYERDIR}/"
BBFILE_PRIORITY_ktest = "6"
```
